 /*Updated.. Try this.. Updated at 11.25am 21/2/2019.. Make video from same angle.. The ending symbol is $    */

bool alpha[37][48]={
{1,1,1,1,1,1,1,1, 1,0,0,0,0,0,0,1, 1,0,0,0,0,0,0,1, 1,0,0,0,0,0,0,1, 1,1,1,1,1,1,1,1, 0,0,0,0,0,0,0,0},     //0
{0,0,0,0,0,0,0,0, 0,0,0,0,0,0,0,0, 0,0,0,0,0,0,0,0, 1,1,1,1,1,1,1,1, 1,1,1,1,1,1,1,1, 0,0,0,0,0,0,0,0},     //1
{1,0,0,0,1,1,1,1, 1,0,0,0,1,0,0,1, 1,0,0,0,1,0,0,1, 1,0,0,0,1,0,0,1, 1,1,1,1,0,0,0,1, 0,0,0,0,0,0,0,0},     //2
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{0,0,0,0,0,0,0,0, 0,0,0,0,0,0,0,0, 0,0,0,0,0,0,0,0, 0,0,0,0,0,0,0,0, 0,0,0,0,0,0,0,0, 0,0,0,0,0,0,0,0}    //Empty = 36
};

int toprint[9]={17,14,21,36,36,36,36,36,36};

//bool n[10][48]={
//{1,1,1,1,1,1,1,1, 1,0,0,0,0,0,0,1, 1,0,0,0,0,0,0,1, 1,0,0,0,0,0,0,1, 1,1,1,1,1,1,1,1, 0,0,0,0,0,0,0,0},     //0
//{0,0,0,0,0,0,0,0, 0,0,0,0,0,0,0,0, 0,0,0,0,0,0,0,0, 1,1,1,1,1,1,1,1, 1,1,1,1,1,1,1,1, 0,0,0,0,0,0,0,0},     //1
//{1,0,0,0,1,1,1,1, 1,0,0,0,1,0,0,1, 1,0,0,0,1,0,0,1, 1,0,0,0,1,0,0,1, 1,1,1,1,0,0,0,1, 0,0,0,0,0,0,0,0},     //2
//{1,0,0,0,1,0,0,1, 1,0,0,0,1,0,0,1, 1,0,0,0,1,0,0,1, 1,0,0,0,1,0,0,1, 1,1,1,1,1,1,1,1, 0,0,0,0,0,0,0,0},     //3
//{1,1,1,1,0,0,0,0, 0,0,0,0,1,0,0,0, 0,0,0,0,1,0,0,0, 0,0,0,0,1,0,0,0, 1,1,1,1,1,1,1,1, 0,0,0,0,0,0,0,0},     //4
//{1,1,1,1,0,0,0,1, 1,0,0,1,0,0,0,1, 1,0,0,1,0,0,0,1, 1,0,0,1,0,0,0,1, 1,0,0,1,1,1,1,1, 0,0,0,0,0,0,0,0},     //5
//{1,1,1,1,1,1,1,1, 1,0,0,1,0,0,0,1, 1,0,0,1,0,0,0,1, 1,0,0,1,0,0,0,1, 1,0,0,1,1,1,1,1, 0,0,0,0,0,0,0,0},     //6
//{1,1,0,0,0,0,0,0, 1,1,0,0,0,0,0,0, 1,1,0,0,0,0,0,0, 1,1,0,0,0,0,0,0, 1,1,1,1,1,1,1,1, 0,0,0,0,0,0,0,0},     //7
//{1,1,1,1,1,1,1,1, 1,0,0,1,1,0,0,1, 1,0,0,1,1,0,0,1, 1,0,0,1,1,0,0,1, 1,1,1,1,1,1,1,1, 0,0,0,0,0,0,0,0},     //8
//{1,1,1,1,0,0,0,1, 1,0,0,1,1,0,0,1, 1,0,0,1,1,0,0,1, 1,0,0,1,1,0,0,1, 1,1,1,1,1,1,1,1, 0,0,0,0,0,0,0,0}      //9
//}
#define BTW_BLADES 73000
int max_dig=9;
int dottime = 4000;    
int sensor = 13;
int State = 0;         
int lastState = 0; 
bool mybool=0;
unsigned long current_micros; 
unsigned long previous_micros1=0,previous_micros2=0,previous_micros3=0,previous_micros4=0;  
int m1=0,m2=0,m3=0;
bool b1init=0,b2init=0,b3init=0;

void setup() {
//max_dig=(4000/dottime) *9;
  Serial1.begin(9600);
  for (int Pin = 30; Pin <=37; Pin++) {
    pinMode(Pin, OUTPUT);}
  for (int Pin = 22; Pin <=29; Pin++) {
    pinMode(Pin, OUTPUT);}
  for (int Pin = 2; Pin <=9; Pin++) {
    pinMode(Pin, OUTPUT);}

  pciSetup(13);

 // pinMode(sensor, INPUT);
}

int i1=0,i2=0,i3=0;
unsigned long T;
int tempcount=0;
int tempvalue=0;
void loop() {
//  State = digitalRead(sensor);
//if (State != lastState){
if((Serial1.available()>0)&&(tempcount<max_dig)){
  tempvalue=int(Serial1.read());
  if(tempvalue>64){tempvalue=tempvalue-65+10;}
  else if(tempvalue>47){ tempvalue=tempvalue-48;}
  else if (tempvalue==36){ 
    for(;tempcount<max_dig;tempcount++){ toprint[tempcount]=36;}
  } 
  else if(tempvalue==32){tempvalue=36;}
  if(tempcount<max_dig){ 
    toprint[tempcount]=tempvalue;
  tempcount++;}
  }
if(tempcount>=max_dig){tempcount=0;}
  if (State == HIGH){
  previous_micros1=micros();
  T=(previous_micros1-previous_micros4)/3.0;
 // dottime=73000.0/T *2000;
//toprint[8] = T %10; 
//toprint[7] = (T / 10) % 10;
//toprint[6] = (T / 100) % 10;
//toprint[5] = (T / 1000) % 10;
//toprint[4] = (T / 10000) % 10;
//toprint[3] = (T / 100000) % 10;
//toprint[2] = 23;
//toprint[1] = 20;
//toprint[0] = 17;

 // previous_micros2=micros();
 // previous_micros3=micros();
  previous_micros4=micros();
  m1=0;
  i1=0;
  b1init=0; b2init=0; b3init=0;
  State=LOW;
  }
//  }
  
current_micros=micros();

if(current_micros-previous_micros4>=T){
  if(!b2init){ i2=0; m2=0; b2init=1;}
}
if(current_micros-previous_micros4>=(2*T)){
 if(!b3init){ i3=0; m3=0; b3init=1;}
}
  
    if((current_micros-previous_micros1>=dottime)&&(m1<48)&&(i1<10)){
      printLetterb1(alpha[toprint[i1]]);
      if(m1>=48){ i1++; m1=0;}
previous_micros1=micros();
    }

    if((current_micros-previous_micros2>=dottime)&&(m2<48)&&(i2<10)){
      printLetterb2(alpha[toprint[i2]]);
      if(m2>=48){i2++; m2=0;}
previous_micros2=micros();
    }

    if((current_micros-previous_micros3>=dottime)&&(m3<48)&&(i3<10)){
      printLetterb3(alpha[toprint[i3]]);
      if(m3>=48){i3++; m3=0;}
previous_micros3=micros();
    }
lastState = State;}


void printLetterb1(bool letter[])
{
  for (int Pin = 30; Pin <=37; Pin++) {
    digitalWrite(Pin, letter[m1]);
    m1++;
    }
  } 

  void printLetterb2(bool letter[])
{
  for (int Pin = 22; Pin <=29; Pin++) {
    digitalWrite(Pin, letter[m2]);
    m2++;
    }
  } 
  
  void printLetterb3(bool letter[])
{
  for (int Pin = 2; Pin <=9; Pin++) {
    digitalWrite(Pin, letter[m3]);
    m3++;
    }
  } 


  // Install Pin change interrupt for a pin, can be called multiple times
 
void pciSetup(byte pin)
{
    *digitalPinToPCMSK(pin) |= bit (digitalPinToPCMSKbit(pin));  // enable pin
    PCIFR  |= bit (digitalPinToPCICRbit(pin)); // clear any outstanding interrupt
    PCICR  |= bit (digitalPinToPCICRbit(pin)); // enable interrupt for the group
}
 
// Use one Routine to handle each group
 
ISR (PCINT0_vect) // handle pin change interrupt for D8 to D13 here
 {    
  if(mybool==0){
 State=1;   
mybool=1;    
  }
  else mybool=0;
 } 
